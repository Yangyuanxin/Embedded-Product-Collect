/*
*********************************************************************************************************
*
*    模块名称 : NTC驱动模块
*    文件名称 : bsp_ntc.c
*    版    本 : V1.1
*    说    明 : 
*
*    修改记录 :
*        版本号    日期           作者          说明
*       V1.0    2017-09-20        armfly          首发
*        V1.1    2019-09-20        armfly          根据参数选择热敏电阻类型。NTC表简化为2列.
*    Copyright (C), 2016-2020, 安富莱电子 www.armfly.com
*
*********************************************************************************************************
*/
#include "bsp.h"
#include "param.h"

/* 温度(摄氏度)，电阻(kΩ)，10K B25/50-3950K */
const float ntc_10K_B3950[] = {
        -55, 739.5,
        -54, 705.664,
        -53, 669.165,
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        125, 0.324,

        /* 结束行，用于搜索判断结束 */
        9999, 0};

/* 温度(摄氏度)，电阻(kΩ)，100K B25/50-3950K */
const float ntc_100K_B3950[] = {
        -40, 3402.936,
        -39, 3184.855,
        -38, 2982.102,
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        300, 0.1406,

        /* 结束行，用于搜索判断结束 */
        9999, 0};

/* 温度(摄氏度)，电阻(kΩ)，200K B25/50-4260K */
const float ntc_200K_B4260[] = {
        -20, 2106.124,
        -19, 1985.095,
        -18, 1871.640,
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        300, 0.1200,

        /* 结束行，用于搜索判断结束 */
        9999, 0};

#define NTC_TYPE_NUM 2
const float *ntc_table[NTC_TYPE_NUM] = {
        ntc_10K_B3950,
        ntc_100K_B3950};

/*
*********************************************************************************************************
*    函 数 名: CalculNtcTemper
*    功能说明: 根据电阻值计算NTC温度值
*    形    参: _res : 电阻值，KΩ
*    返 回 值: 温度值
*   优 先 级: 无
*********************************************************************************************************
*/
float CalculNtcTemperFloat(float _res)
{
    uint16_t i;
    float x1, y1, x2, y2;
    uint16_t idx;
    const float *pTable;
    float temper;

    if (g_tParam.NtcType >= NTC_TYPE_NUM)
    {
        g_tParam.NtcType = 0;
    }
    pTable = ntc_table[g_tParam.NtcType];

    idx = 0;

    /* 搜索当前电阻对应的温度 */
    for (i = 0; i < 500; i++)
    {
        if (_res > pTable[2 * i + 1])
        {
            if (i > 0)
            {
                idx = i - 1;
            }
            else
            {
                idx = 0;
            }
            break;
        }
        if (pTable[2 * i + 0] == 9999)
        {
            idx = i - 2;
            break;
        }
    }

    x1 = pTable[2 * idx + 1];                /* 电阻 */
    y1 = pTable[2 * idx + 0];                /* 温度 */
    x2 = pTable[2 * (idx + 1) + 1]; /* 电阻 */
    y2 = pTable[2 * (idx + 1) + 0]; /* 温度 */

    temper = CaculTwoPointFloat(x1, y1, x2, y2, _res);

    return temper;
}

/*
*********************************************************************************************************
*    函 数 名: CalculNtcRes
*    功能说明: 计算NTC电阻值
*    形    参: ref_res : 上拉参考电阻， _adc : 当前ADC值  
*    返 回 值: 电阻值. K欧
* 
*********************************************************************************************************
*/
float CalculNtcRes(float _adc)
{
    /* 
        大于20欧按 参考电阻比值计算
        小于20欧按第1点和第2点进行线性计算，简单处理。    
    
        这个方案不太好，后面需要找更好的修正算法。
        问题在第2个点附近，阻值会调动3左右.
    */
    float X;
    float ref_res3;
    //    float ref_res2;

    /* 根据 (x2,y2) 校准点和 (x3,y3) 校准点，修正曲线 */

    if (_adc < g_tCalib.NtcRes.x2 + 5)
    {
        X = CaculTwoPointFloat(g_tCalib.NtcRes.x1, g_tCalib.NtcRes.y1, g_tCalib.NtcRes.x2, g_tCalib.NtcRes.y2, _adc);

        /* 0 ->0  9 -> 10  20->20 临时处理 */
        if (X < 9)
        {
            X = CaculTwoPointFloat(0, 0, 9, 10, X);
        }
        else
        {
            X = CaculTwoPointFloat(9, 10, 20, 20, X);
        }
    }
    else
    {
        ref_res3 = CalculRefRes(g_tCalib.NtcRes.x3, g_tCalib.NtcRes.y3); /* 计算内部上拉电阻 */
        /*
        公式  X/(R+X) = ADC/65535
        
        X = ADC * R /(65535 - ADC);
        */

        X = _adc * ref_res3 / (65535 - _adc);
    }

    if (X < 0)
    {
        X = 0;
    }

    return X;
}

/*
*********************************************************************************************************
*    函 数 名: CalculRefRes
*    功能说明: 计算内部电路参考电阻
*    形    参: _adc : 当前ADC值, _res : 标定电阻，K欧
*    返 回 值: 电阻值. K欧
* 
*********************************************************************************************************
*/
float CalculRefRes(float _adc, float _res)
{
    /* 参考电阻比值方案 */
    float X;

    /*
    公式  Rx / (Rf + Rx) = ADC/65535
    
        Rx = ADC * Rf /(65535 - ADC);
        Rf = Rx /(ADC/(65535 - ADC));
    */

    X = _res / (_adc / (65535 - _adc));

    return X;
}

/***************************** 安富莱电子 www.armfly.com (END OF FILE) *********************************/
