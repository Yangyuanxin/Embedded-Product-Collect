#include "RTL.h"
#include "stm32f10x.h"
#include "dbg.h"
#include "em.h"
#include "sys_cfg.h"
#include "bms.h"
#include "evc.h"

#if 1
#define EM_MSG dbg_msg
#define EM_ERROR dbg_error
#else
#define EM_MSG (void)
#define EM_ERROR (void)
#endif


em_info_def em_info;

extern int em_wait_frame(u8** addr, u16* len);
extern void em_usart_send(u8* buf, u8 lenth);

u8* em_rx_addr;
u16 em_rx_len;

u8 mb_send_buf[50];

u16 mb_crc16(u8* puchMsg, u8 usDataLen);

/*
 * @brief           写寄存器(功能码0x10)
 * @param addr      从机地址
 * @param reg_addr  寄存器地址
 * @param cnt       寄存器数量
 * @param buf  		寄存器值数据
 * @retval 1 成功   0 失败
 */
int host_mb_write_10H(u8 addr, u16 reg_addr, u8 cnt, u16 *buf)
{
//	u8 i, *temp;
//	u16 crc;
//	mb_send_buf[0] = addr;  //从机地址
//	mb_send_buf[1] = 0x10;  //功能码
//	mb_send_buf[2] = (u8)(reg_addr >> 8);  //寄存器地址
//	mb_send_buf[3] = (u8)reg_addr;
//	mb_send_buf[4] = (u8)(cnt >> 8);  //寄存器数量
//	mb_send_buf[5] = (u8)cnt;
//	mb_send_buf[6] = cnt * 2;  //字节数
//
//	temp = &mb_send_buf[7];
//	for(i = 0; i < cnt; i++)  //寄存器数据
//	{
//		*temp++ = (u8)(buf[i] >> 8);
//		*temp++ = (u8)buf[i];
//	}
//
//	crc = mb_crc16(mb_send_buf, 7 + cnt * 2);  //计算crc
//	*temp++ = (u8)crc;
//	*temp   = (u8)(crc >> 8);
//
//	usart1_send(mb_send_buf, 9 + cnt * 2);  //发送
//
//	if(os_sem_wait(&usart1_rx_sem, 100) != OS_R_TMO)  //等待从机响应
//	{
//		if((usart1_rx_buf[0] == addr) && (usart1_rx_buf[1] == 0x10))
//		{
//			u16 temp_crc = (usart1_rx_buf[usart1_rx_len - 1] << 8) | usart1_rx_buf[usart1_rx_len - 2];
//			if(temp_crc == mb_crc16(usart1_rx_buf, usart1_rx_len - 2))  //校验CRC
//			{
//				return 1;  //成功
//			}
//		}
//	}

	return 0;  //失败
}


/*
 * @brief           读寄存器(功能码0x03)
 * @param addr      从机地址
 * @param reg_addr  寄存器地址
 * @param cnt       寄存器数量
 * @param buf  		寄存器值数据
 * @retval 1 成功   0 失败
 */
static int host_mb_read_03H(u8 addr, u16 reg_addr, u8 cnt, u16 *buf)
{
	u8 i;
	u16 crc;
	mb_send_buf[0] = addr;  //从机地址
	mb_send_buf[1] = 0x03;  //功能码
	mb_send_buf[2] = (u8)(reg_addr >> 8);  //寄存器地址
	mb_send_buf[3] = (u8)reg_addr;
	mb_send_buf[4] = (u8)(cnt >> 8);  //寄存器数量
	mb_send_buf[5] = (u8)cnt;

	crc = mb_crc16(mb_send_buf, 6);  //计算crc
	mb_send_buf[6] = (u8)crc;
	mb_send_buf[7]   = (u8)(crc >> 8);

	em_usart_send(mb_send_buf, 8);  //发送

	if(em_wait_frame(&em_rx_addr, &em_rx_len))  //等待从机响应
	{
		if((em_rx_addr[0] == addr) && (em_rx_addr[1] == 0x03) && (em_rx_addr[2] == cnt * 2))
		{
			u16 temp_crc = (em_rx_addr[em_rx_len - 1] << 8) | em_rx_addr[em_rx_len - 2];
			if(temp_crc == mb_crc16(em_rx_addr, em_rx_len - 2))  //校验CRC
			{
				for(i = 0; i < cnt; i++)
				{
					buf[i] = (em_rx_addr[3 + i * 2]) << 8 | em_rx_addr[4 + i * 2];  //转换为小端
				}
				return 1;
			}
		}
	}

	return 0;  //失败
}


/*
 * @brief           读电表度数
 * @param kwh  		数据保存地址  返回度数  单位0.01度
 * @retval 1 成功   0 失败
 */
int em_read_kwh(u32 *kwh)
{
	u16 temp[2];
	u8 cnt = 3;
	do
	{
		if(host_mb_read_03H(1, 40200, 2, temp))
		{
			*kwh = (temp[0] << 16) | temp[1];
			return 1;
		}
		cnt--;
		os_dly_wait(120);
	}while(cnt);
	return 0;
}




//输出电量计算
__int64 kwh_ws;
u32 kwh_t;
u16 kwh_v, kwh_i;
u32 kwh_soft;

/*
 * @brief           电费计算初始化  软件计算
 * @retval 1 成功   0 失败
 */
int em_calc_init_soft()
{
	kwh_ws = 0;
	kwh_t = bms_info.timer_tick;
	kwh_v = 0;
	kwh_i = 0;
	kwh_soft = 0;
	return 1;
}

/*
 * @brief     电费计算   需要读电表,由于电表与显示屏共用一路485所以此函数需在LCD线程中调用
 * @retval 1 成功   0 失败
 */
int em_calc_soft()
{
	kwh_ws += ((kwh_v * kwh_i / 10) * (bms_info.timer_tick - kwh_t)) / 100;
	kwh_t = bms_info.timer_tick;

	kwh_v = evc_info.read.v;
	kwh_i = evc_info.read.i;

	kwh_soft = (u16)(kwh_ws  / 3600000);  //更新用电度数
	return 1;
}




u32 em_kwh0;  //电表初始读数
u32 em_sum;   //金额
/*
 * @brief           电费计算初始化   需要读电表,由于电表与显示屏共用一路485所以此函数需在LCD线程中调用
 * @retval 1 成功   0 失败
 */
int em_calc_init()
{
	int ret;
	em_sum = 0;
	em_info.kwh = 0;
	em_info.sum = 0;
	em_info.err_cnt = 0;
	em_calc_init_soft();
	ret = em_read_kwh(&em_kwh0);  //读电表初始读数
	if(ret)
	{
		em_info.kwh_cnt = em_kwh0;
	}
	return ret;
}

/*
 * @brief     电费计算   需要读电表,由于电表与显示屏共用一路485所以此函数需在LCD线程中调用
 * @retval 1 成功   0 失败
 */
int em_calc()
{
	int ret;
	u32 temp = 0;
	em_calc_soft();

	ret = em_read_kwh(&temp);
	if(ret)  //读取成功
	{
		em_info.err_cnt = 0;

		em_info.kwh_cnt = temp;

		if(temp >= em_kwh0)
		{
			temp = temp - em_kwh0;
		}
		else
		{
			temp = (99999999 - em_kwh0) + temp;
		}

		if(temp < kwh_soft)
		{
			temp = kwh_soft;  //使用软件计算电量
		}
	}
	else  //读取失败
	{
		if(em_info.kwh < kwh_soft)
		{
			em_info.kwh = kwh_soft;  //使用软件计算电量
			em_sum = (em_info.kwh * sys_cfg.e_price) / 100;
			em_info.sum = em_sum;  //更新金额
		}

		return 0;
	}

	em_sum = (temp * sys_cfg.e_price) / 100;
	em_info.kwh = temp;  //更新用电度数
	em_info.sum = em_sum;  //更新金额
	return 1;
}

/*
 * @brief           测试电表连接  由于电表与显示屏共用一路485所以此函数需在LCD线程中调用
 * @retval 1 成功   0 失败
 */
int em_link_isok()
{
	u16 temp[2];
	u8 cnt = 2;

	do
	{
		if(host_mb_read_03H(1, 40200, 2, temp))  //读软件版本
		{
			return 1;  //读取成功
		}
		cnt--;
	}while(cnt);
	return 0;
}

const u8 mb_auchCRCHi[] =
{
		0x00, 0xC1, 0x81, 0x40, 0x01, 0xC0, 0x80, 0x41, 0x01, 0xC0, 0x80, 0x41, 0x00, 0xC1, 0x81,
		0x40, 0x01, 0xC0, 0x80, 0x41, 0x00, 0xC1, 0x81, 0x40, 0x00, 0xC1, 0x81, 0x40, 0x01, 0xC0,
		0x80, 0x41, 0x01, 0xC0, 0x80, 0x41, 0x00, 0xC1, 0x81, 0x40, 0x00, 0xC1, 0x81, 0x40, 0x01,
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		0x00, 0xC1, 0x81, 0x40, 0x01, 0xC0, 0x80, 0x41, 0x01, 0xC0, 0x80, 0x41, 0x00, 0xC1, 0x81,
		0x40
};

const u8 mb_auchCRCLo[] =
{
		0x00, 0xC0, 0xC1, 0x01, 0xC3, 0x03, 0x02, 0xC2, 0xC6, 0x06, 0x07, 0xC7, 0x05, 0xC5, 0xC4,
		0x04, 0xCC, 0x0C, 0x0D, 0xCD, 0x0F, 0xCF, 0xCE, 0x0E, 0x0A, 0xCA, 0xCB, 0x0B, 0xC9, 0x09,
		0x08, 0xC8, 0xD8, 0x18, 0x19, 0xD9, 0x1B, 0xDB, 0xDA, 0x1A, 0x1E, 0xDE, 0xDF, 0x1F, 0xDD,
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		0x44, 0x84, 0x85, 0x45, 0x87, 0x47, 0x46, 0x86, 0x82, 0x42, 0x43, 0x83, 0x41, 0x81, 0x80,
		0x40
};


u16 mb_crc16(u8* puchMsg,u8 usDataLen)
{
	u8 uchCRCHi = 0xFF;
	u8 uchCRCLo = 0xFF;
	unsigned int  uIndex;
	while (usDataLen--)
	{
		uIndex = uchCRCLo ^ *puchMsg++ ; /* 计算CRC */
		uchCRCLo = uchCRCHi ^ mb_auchCRCHi[uIndex];
		uchCRCHi = mb_auchCRCLo[uIndex] ;
	}
	return (((unsigned int)(uchCRCHi) << 8) | uchCRCLo) ;
}
