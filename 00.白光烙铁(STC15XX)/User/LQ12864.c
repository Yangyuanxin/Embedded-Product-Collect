#include "LQ12864.h"

sbit OLED_SCL	= P2^4;
sbit OLED_SDA	= P2^3;
sbit OLED_RST	= P2^2;
sbit OLED_DC 	= P2^1;
sbit OLED_CS	= P2^0;

unsigned char code Logo[1024] = 
{
	0x00,0x00,0x00,0x00,0x00,0x00,0x00,0x00,0x00,0x00,0x00,0x00,0x00,0x00,0x00,0x00,0x00,0x00,0x00,0x00,0x00,0x00,0x00,0x00,0x00,0x00,0x00,0x00,0x00,0x00,0x00,0x00,
	0x00,0x00,0x00,0x00,0x00,0x00,0x00,0x00,0x00,0x00,0x00,0x00,0x00,0x00,0x00,0x00,0x00,0x00,0x00,0x00,0x00,0x00,0x00,0x00,0x00,0x00,0x80,0x80,0x80,0x00,0x00,0x00,
	0x00,0x00,0x00,0x00,0x00,0x00,0x00,0x00,0x00,0x00,0x00,0x00,0x00,0x00,0x00,0x00,0x00,0x00,0x00,0x00,0x00,0x00,0x00,0x00,0x00,0x00,0x00,0x00,0x00,0x00,0x00,0x00,
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	0x03,0x00,0x00,0x00,0x02,0x02,0x03,0x01,0x00,0x03,0x03,0x00,0x00,0x01,0x03,0x02,0x00,0x00,0x0D,0x0F,0x03,0x00,0x00,0x00,0x00,0x00,0x00,0x00,0x00,0x00,0x00,0x00
};
	
//unsigned char code F6x8[][6] =
//{
//    { 0x00, 0x00, 0x00, 0x00, 0x00, 0x00 },   // sp
//    { 0x00, 0x00, 0x00, 0x2f, 0x00, 0x00 },   // !
//    { 0x00, 0x00, 0x07, 0x00, 0x07, 0x00 },   // "
//    { 0x00, 0x14, 0x7f, 0x14, 0x7f, 0x14 },   // #
//    { 0x00, 0x24, 0x2a, 0x7f, 0x2a, 0x12 },   // $
//    { 0x00, 0x62, 0x64, 0x08, 0x13, 0x23 },   // %
//    { 0x00, 0x36, 0x49, 0x55, 0x22, 0x50 },   // &
//    { 0x00, 0x00, 0x05, 0x03, 0x00, 0x00 },   // '
//    { 0x00, 0x00, 0x1c, 0x22, 0x41, 0x00 },   // (
//    { 0x00, 0x00, 0x41, 0x22, 0x1c, 0x00 },   // )
//    { 0x00, 0x14, 0x08, 0x3E, 0x08, 0x14 },   // *
//    { 0x00, 0x08, 0x08, 0x3E, 0x08, 0x08 },   // +
//    { 0x00, 0x00, 0x00, 0xA0, 0x60, 0x00 },   // ,
//    { 0x00, 0x08, 0x08, 0x08, 0x08, 0x08 },   // -
//    { 0x00, 0x00, 0x60, 0x60, 0x00, 0x00 },   // .
//    { 0x00, 0x20, 0x10, 0x08, 0x04, 0x02 },   // /
//    { 0x00, 0x3E, 0x51, 0x49, 0x45, 0x3E },   // 0
//    { 0x00, 0x00, 0x42, 0x7F, 0x40, 0x00 },   // 1
//    { 0x00, 0x42, 0x61, 0x51, 0x49, 0x46 },   // 2
//    { 0x00, 0x21, 0x41, 0x45, 0x4B, 0x31 },   // 3
//    { 0x00, 0x18, 0x14, 0x12, 0x7F, 0x10 },   // 4
//    { 0x00, 0x27, 0x45, 0x45, 0x45, 0x39 },   // 5
//    { 0x00, 0x3C, 0x4A, 0x49, 0x49, 0x30 },   // 6
//    { 0x00, 0x01, 0x71, 0x09, 0x05, 0x03 },   // 7
//    { 0x00, 0x36, 0x49, 0x49, 0x49, 0x36 },   // 8
//    { 0x00, 0x06, 0x49, 0x49, 0x29, 0x1E },   // 9
//    { 0x00, 0x00, 0x36, 0x36, 0x00, 0x00 },   // :
//    { 0x00, 0x00, 0x56, 0x36, 0x00, 0x00 },   // ;
//    { 0x00, 0x08, 0x14, 0x22, 0x41, 0x00 },   // <
//    { 0x00, 0x14, 0x14, 0x14, 0x14, 0x14 },   // =
//    { 0x00, 0x00, 0x41, 0x22, 0x14, 0x08 },   // >
//    { 0x00, 0x02, 0x01, 0x51, 0x09, 0x06 },   // ?
//    { 0x00, 0x32, 0x49, 0x59, 0x51, 0x3E },   // @
//    { 0x00, 0x7C, 0x12, 0x11, 0x12, 0x7C },   // A
//    { 0x00, 0x7F, 0x49, 0x49, 0x49, 0x36 },   // B
//    { 0x00, 0x3E, 0x41, 0x41, 0x41, 0x22 },   // C
//    { 0x00, 0x7F, 0x41, 0x41, 0x22, 0x1C },   // D
//    { 0x00, 0x7F, 0x49, 0x49, 0x49, 0x41 },   // E
//    { 0x00, 0x7F, 0x09, 0x09, 0x09, 0x01 },   // F
//    { 0x00, 0x3E, 0x41, 0x49, 0x49, 0x7A },   // G
//    { 0x00, 0x7F, 0x08, 0x08, 0x08, 0x7F },   // H
//    { 0x00, 0x00, 0x41, 0x7F, 0x41, 0x00 },   // I
//    { 0x00, 0x20, 0x40, 0x41, 0x3F, 0x01 },   // J
//    { 0x00, 0x7F, 0x08, 0x14, 0x22, 0x41 },   // K
//    { 0x00, 0x7F, 0x40, 0x40, 0x40, 0x40 },   // L
//    { 0x00, 0x7F, 0x02, 0x0C, 0x02, 0x7F },   // M
//    { 0x00, 0x7F, 0x04, 0x08, 0x10, 0x7F },   // N
//    { 0x00, 0x3E, 0x41, 0x41, 0x41, 0x3E },   // O
//    { 0x00, 0x7F, 0x09, 0x09, 0x09, 0x06 },   // P
//    { 0x00, 0x3E, 0x41, 0x51, 0x21, 0x5E },   // Q
//    { 0x00, 0x7F, 0x09, 0x19, 0x29, 0x46 },   // R
//    { 0x00, 0x46, 0x49, 0x49, 0x49, 0x31 },   // S
//    { 0x00, 0x01, 0x01, 0x7F, 0x01, 0x01 },   // T
//    { 0x00, 0x3F, 0x40, 0x40, 0x40, 0x3F },   // U
//    { 0x00, 0x1F, 0x20, 0x40, 0x20, 0x1F },   // V
//    { 0x00, 0x3F, 0x40, 0x38, 0x40, 0x3F },   // W
//    { 0x00, 0x63, 0x14, 0x08, 0x14, 0x63 },   // X
//    { 0x00, 0x07, 0x08, 0x70, 0x08, 0x07 },   // Y
//    { 0x00, 0x61, 0x51, 0x49, 0x45, 0x43 },   // Z
//    { 0x00, 0x00, 0x7F, 0x41, 0x41, 0x00 },   // [
//    { 0x00, 0x55, 0x2A, 0x55, 0x2A, 0x55 },   // 55
//    { 0x00, 0x00, 0x41, 0x41, 0x7F, 0x00 },   // ]
//    { 0x00, 0x04, 0x02, 0x01, 0x02, 0x04 },   // ^
//    { 0x00, 0x40, 0x40, 0x40, 0x40, 0x40 },   // _
//    { 0x00, 0x00, 0x00, 0x02, 0x05, 0x02 },   // 摄氏度的圈
//    { 0x00, 0x20, 0x54, 0x54, 0x54, 0x78 },   // a
//    { 0x00, 0x7F, 0x48, 0x44, 0x44, 0x38 },   // b
//    { 0x00, 0x38, 0x44, 0x44, 0x44, 0x20 },   // c
//    { 0x00, 0x38, 0x44, 0x44, 0x48, 0x7F },   // d
//    { 0x00, 0x38, 0x54, 0x54, 0x54, 0x18 },   // e
//    { 0x00, 0x08, 0x7E, 0x09, 0x01, 0x02 },   // f
//    { 0x00, 0x18, 0xA4, 0xA4, 0xA4, 0x7C },   // g
//    { 0x00, 0x7F, 0x08, 0x04, 0x04, 0x78 },   // h
//    { 0x00, 0x00, 0x44, 0x7D, 0x40, 0x00 },   // i
//    { 0x00, 0x40, 0x80, 0x84, 0x7D, 0x00 },   // j
//    { 0x00, 0x7F, 0x10, 0x28, 0x44, 0x00 },   // k
//    { 0x00, 0x00, 0x41, 0x7F, 0x40, 0x00 },   // l
//    { 0x00, 0x7C, 0x04, 0x18, 0x04, 0x78 },   // m
//    { 0x00, 0x7C, 0x08, 0x04, 0x04, 0x78 },   // n
//    { 0x00, 0x38, 0x44, 0x44, 0x44, 0x38 },   // o
//    { 0x00, 0xFC, 0x24, 0x24, 0x24, 0x18 },   // p
//    { 0x00, 0x18, 0x24, 0x24, 0x18, 0xFC },   // q
//    { 0x00, 0x7C, 0x08, 0x04, 0x04, 0x08 },   // r
//    { 0x00, 0x48, 0x54, 0x54, 0x54, 0x20 },   // s
//    { 0x00, 0x04, 0x3F, 0x44, 0x40, 0x20 },   // t
//    { 0x00, 0x3C, 0x40, 0x40, 0x20, 0x7C },   // u
//    { 0x00, 0x1C, 0x20, 0x40, 0x20, 0x1C },   // v
//    { 0x00, 0x3C, 0x40, 0x30, 0x40, 0x3C },   // w
//    { 0x00, 0x44, 0x28, 0x10, 0x28, 0x44 },   // x
//    { 0x00, 0x1C, 0xA0, 0xA0, 0xA0, 0x7C },   // y
//    { 0x00, 0x44, 0x64, 0x54, 0x4C, 0x44 },   // z
//    { 0x14, 0x14, 0x14, 0x14, 0x14, 0x14 }    // horiz lines
//};
unsigned char code F14x16_Idx[] = 
{
	"菜单温度时间其它设置最高休眠关屏工作模式烙铁头选择振动灵敏度蜂鸣器音量贷记整场通道工厂中校准调整电压编码器每摄氏度按下一次请在保存转动放弃成功退出设定默认恢复步进参书短继续长已护"
};
unsigned char code F14x16[] = 
{ 
 	
0x00,0x00,0x08,0xC8,0x48,0x3E,0x68,0xB8,0x2E,0x28,0xD8,0x08,0x04,0x00,
0x00,0x44,0x44,0x24,0x14,0x0C,0x7F,0x04,0x0A,0x15,0x24,0x64,0x42,0x00,/*"菜",0*/

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0x00,0x02,0x41,0x7F,0x41,0x30,0x0F,0x01,0x01,0x01,0x01,0x01,0x01,0x00,/*"护",0*/
};

//======================================================
// 128X64I液晶底层驱动[8X16]字体库
// 设计者: powerint
// 描  述: [8X16]西文字符的字模数据 (纵向取模,字节倒序)
// !"#$%&'()*+,-./0123456789:;<=>?@ABCDEFGHIJKLMNOPQRSTUVWXYZ[\]^_`abcdefghijklmnopqrstuvwxyz{|}~
//======================================================
unsigned char code F8X16[]=
{
	0x00,0x00,0x00,0x00,0x00,0x00,0x00,0x00,0x00,0x00,0x00,0x00,0x00,0x00,0x00,0x00,// 0
  0x00,0x00,0x00,0xF8,0x00,0x00,0x00,0x00,0x00,0x00,0x00,0x33,0x30,0x00,0x00,0x00,//!1
  0x00,0x10,0x0C,0x06,0x10,0x0C,0x06,0x00,0x00,0x00,0x00,0x00,0x00,0x00,0x00,0x00,//"2
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  0x00,0x06,0x01,0x01,0x02,0x02,0x04,0x04,0x00,0x00,0x00,0x00,0x00,0x00,0x00,0x00,//~94

};
unsigned char code F16X32_Idx[] = 
{
	"0123456789`C"
};
unsigned char code F16X32[]=
{
	0x00, 0x00, 0x80, 0xC0, 0xE0, 0xF0, 0x70, 0x38, 0x38, 0x78, 0xF0, 0xF0, 0xE0, 0xC0,
	0x00, 0x00, 0x00, 0xFC, 0xFF, 0xFF, 0xFF, 0x03, 0x00, 0x00, 0x00, 0x00, 0x00, 0x07,
	0xFF, 0xFF, 0xFF, 0xF0, 0x00, 0x1F, 0xFF, 0xFF, 0xFF, 0xE0, 0x00, 0x00, 0x00, 0x00,
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	0x00, 0x00, 0x00, 0x00, 0x00, 0x00, 0x00, 0x00// 
};
void OLED_WrDat(unsigned char dat)
{
	unsigned char i=8;
	OLED_CS=0;;
	OLED_DC=1;
  OLED_SCL=0;
  _nop_();    
  while(i--)
  {
    if(dat&0x80){OLED_SDA=1;}
    else{OLED_SDA=0;}
    OLED_SCL=1; 
    _nop_();;
		_nop_();            
    OLED_SCL=0;;    
    dat<<=1;    
  }
	OLED_CS=1;
}
void OLED_WrCmd(unsigned char cmd)
{
	unsigned char i=8;
	
	OLED_CS=0;;
	OLED_DC=0;;
  OLED_SCL=0;;
  _nop_();   
  while(i--)
  {
    if(cmd&0x80){OLED_SDA=1;}
    else{OLED_SDA=0;;}
    OLED_SCL=1;;
    _nop_();;
		_nop_();             
    OLED_SCL=0;;    
    cmd<<=1;;   
  } 	
	OLED_CS=1;
}
void OLED_Set_Pos(unsigned char x, unsigned char y)
{ 
  OLED_WrCmd(0xb0+y);
  OLED_WrCmd(((x&0xf0)>>4)|0x10);
  OLED_WrCmd((x&0x0f)|0x01); 
} 
void OLED_Fill(unsigned char bmp_data)
{
	unsigned char y,x;
	
	for(y=0;y<8;y++)
	{
		OLED_WrCmd(0xb0+y);
		OLED_WrCmd(0x01);
		OLED_WrCmd(0x10);
		for(x=0;x<X_WIDTH;x++)
			OLED_WrDat(bmp_data);
	}
}
void OLED_CLS(void)
{
	unsigned char y,x;	
	for(y=0;y<8;y++)
	{
		OLED_WrCmd(0xb0+y);
		OLED_WrCmd(0x01);
		OLED_WrCmd(0x10); 
		for(x=0;x<X_WIDTH;x++)
			OLED_WrDat(0);
	}
}

void OLED_Init(void)        
{  
	OLED_SCL=1;
	OLED_CS=1;	//预制SLK和SS为高电平   	
	
	OLED_RST=0;
	Delay_ms(50);
	OLED_RST=1;

  OLED_WrCmd(0xae);//--turn off oled panel
  OLED_WrCmd(0x00);//---set low column address
  OLED_WrCmd(0x10);//---set high column address
  OLED_WrCmd(0x40);//--set start line address  Set Mapping RAM Display Start Line (0x00~0x3F)
  OLED_WrCmd(0x81);//--set contrast control register
  OLED_WrCmd(0xcf); // Set SEG Output Current Brightness
  OLED_WrCmd(0xa1);//--Set SEG/Column Mapping     0xa0左右反置 0xa1正常
  OLED_WrCmd(0xc8);//Set COM/Row Scan Direction   0xc0上下反置 0xc8正常
  OLED_WrCmd(0xa6);//--set normal display
  OLED_WrCmd(0xa8);//--set multiplex ratio(1 to 64)
  OLED_WrCmd(0x3f);//--1/64 duty
  OLED_WrCmd(0xd3);//-set display offset	Shift Mapping RAM Counter (0x00~0x3F)
  OLED_WrCmd(0x00);//-not offset
  OLED_WrCmd(0xd5);//--set display clock divide ratio/oscillator frequency
  OLED_WrCmd(0x80);//--set divide ratio, Set Clock as 100 Frames/Sec
  OLED_WrCmd(0xd9);//--set pre-charge period
  OLED_WrCmd(0xf1);//Set Pre-Charge as 15 Clocks & Discharge as 1 Clock
  OLED_WrCmd(0xda);//--set com pins hardware configuration
  OLED_WrCmd(0x12);
  OLED_WrCmd(0xdb);//--set vcomh
  OLED_WrCmd(0x40);//Set VCOM Deselect Level
  OLED_WrCmd(0x20);//-Set Page Addressing Mode (0x00/0x01/0x02)
  OLED_WrCmd(0x02);//
  OLED_WrCmd(0x8d);//--set Charge Pump enable/disable
  OLED_WrCmd(0x14);//--set(0x10) disable
  OLED_WrCmd(0xa4);// Disable Entire Display On (0xa4/0xa5)
  OLED_WrCmd(0xa6);// Disable Inverse Display On (0xa6/a7) 
  OLED_WrCmd(0xaf);//--turn on oled panel
  OLED_Fill(0x00);  //初始清屏
  OLED_Set_Pos(0,0);  
	
} 

////==============================================================
////函数名： void OLED_PutPixel(unsigned char x,unsigned char y)
////功能描述：绘制一个点（x,y）
////参数：真实坐标值(x,y),x的范围0～127，y的范围0～64
////返回：无
////==============================================================
//void OLED_PutPixel(unsigned char x,unsigned char y)
//{
//	unsigned char data1;  //data1当前点的数据 

//	OLED_Set_Pos(x,(unsigned char)(y>>3)); 
//	data1 =(unsigned char)(0x01<<(y%8)); 	
//	OLED_WrCmd((unsigned char)(0xb0+(y>>3)));
//	OLED_WrCmd((unsigned char)(((x&0xf0)>>4)|0x10));
//	OLED_WrCmd((unsigned char)((x&0x0f)|0x00));
//	OLED_WrDat(data1); 	 	
//}
////==============================================================
////函数名： void OLED_Rectangle(unsigned char x1,unsigned char y1,
////                   unsigned char x2,unsigned char y2,unsigned char color,unsigned char gif)
////功能描述：绘制一个实心矩形
////参数：左上角坐标（x1,y1）,右下角坐标（x2，y2）
////      其中x1、x2的范围0～127，y1，y2的范围0～63，即真实坐标值
////返回：无
////==============================================================
//void OLED_Rectangle(unsigned char x1,unsigned char y1,unsigned char x2,unsigned char y2,unsigned char gif)
//{
//	unsigned char n; 
//		
//	OLED_Set_Pos(x1,y1>>3);
//	for(n=x1;n<=x2;n++)
//	{
//		OLED_WrDat(0x01<<(y1%8)); 			
//		if(gif == 1) 	Delay_ms(50);
//	}  
//	OLED_Set_Pos(x1,y2>>3);
//  for(n=x1;n<=x2;n++)
//	{
//		OLED_WrDat(0x01<<(y2%8)); 			
//		if(gif == 1) 	Delay_ms(5);
//	}
//	
//}  
////==============================================================
////函数名：OLED_P6x8Str(unsigned char x,unsigned char y,unsigned char *p)
////功能描述：写入一组标准ASCII字符串
////参数：显示的位置（x,y），y为页范围0～7，要显示的字符串
////返回：无
////==============================================================  
//void OLED_P6x8Str(unsigned char x,unsigned char y,unsigned char ch[])
//{
//  unsigned char c=0,i=0,j=0;      
//  while (ch[j]!='\0')
//  {    
//    c =ch[j]-32;
//    if(x>126){x=0;y++;}
//    OLED_Set_Pos(x,y);    
//  	for(i=0;i<6;i++)     
//  	  OLED_WrDat(F6x8[c][i]);  
//  	x+=6;
//  	j++;
//  }
//}
//==============================================================
//函数名：OLED_P8x16Str(unsigned char x,unsigned char y,unsigned char *p)
//功能描述：写入一组标准ASCII字符串
//参数：显示的位置（x,y），y为页范围0～7，要显示的字符串
//返回：无
//==============================================================  
void OLED_P8x16Str(unsigned char x,unsigned char y,unsigned char ch[])
{
  unsigned char c=0,i=0,j=0;
        
  while (ch[j]!='\0')
  {    
    c =ch[j]-32;
    if(x>120){x=0;y++;}
    OLED_Set_Pos(x,y);    
  	for(i=0;i<8;i++)     
  	  OLED_WrDat(F8X16[c*16+i]);
  	OLED_Set_Pos(x,y+1);    
  	for(i=0;i<8;i++)     
  	  OLED_WrDat(F8X16[c*16+i+8]);  
  	x+=8;
  	j++;
  }
}
//显示16x32大字温度
void OLED_P16x32Temp(unsigned char x,unsigned char y,unsigned char ch[])
{
  unsigned char c=0,i=0,j=0;
        
  while (ch[j]!='\0')
  {    
		if(ch[j]!='`' && ch[j]!='C' && ch[j]!='-' && ch[j]!=' ')
			c =ch[j]-48;
		else if(ch[j]=='`')
			c = 10;
		else if(ch[j]=='C')
			c = 11;
		else if(ch[j]=='-')
			c = 12;
		else
			c = 13;
			
    if(x>120)
		{
			x=0;
			//y++;
		}
    OLED_Set_Pos(x,y);    
  	for(i=0;i<16;i++)     
  	  OLED_WrDat(F16X32[c*64+i]);
  	OLED_Set_Pos(x,y+1);    
  	for(i=0;i<16;i++)     
  	  OLED_WrDat(F16X32[c*64+i+16]);  
  	OLED_Set_Pos(x,y+2);    
  	for(i=0;i<16;i++)     
  	  OLED_WrDat(F16X32[c*64+i+32]); 
  	OLED_Set_Pos(x,y+3);    
  	for(i=0;i<16;i++)     
  	  OLED_WrDat(F16X32[c*64+i+48]); 
  	x+=16;
  	j++;
  }
}
//输出汉字字符串
void OLED_P14x16Str(unsigned char x,unsigned char y,unsigned char ch[])
{
	unsigned char wm=0,ii = 0;
	unsigned int adder=1; 
	
	while(ch[ii] != '\0')
	{
  	wm = 0;
  	adder = 1;
  	while(F14x16_Idx[wm] > 127)
  	{
  		if(F14x16_Idx[wm] == ch[ii])
  		{
  			if(F14x16_Idx[wm + 1] == ch[ii + 1])
  			{
  				adder = wm * 14;
  				break;
  			}
  		}
  		wm += 2;			
  	}
  	if(x>118){x=0;y++;}
  	OLED_Set_Pos(x , y); 
  	if(adder != 1)// 显示汉字					
  	{
  		OLED_Set_Pos(x , y);
  		for(wm = 0;wm < 14;wm++)               
  		{
  			OLED_WrDat(F14x16[adder]);	
  			adder += 1;
  		}      
  		OLED_Set_Pos(x,y + 1); 
  		for(wm = 0;wm < 14;wm++)          
  		{
  			OLED_WrDat(F14x16[adder]);
  			adder += 1;
  		}   		
  	}
  	else			  //显示空白字符			
  	{
  		ii += 1;
      OLED_Set_Pos(x,y);
  		for(wm = 0;wm < 16;wm++)
  		{
  				OLED_WrDat(0);
  		}
  		OLED_Set_Pos(x,y + 1);
  		for(wm = 0;wm < 16;wm++)
  		{   		
  				OLED_WrDat(0);	
  		}
  	}
  	x += 14;
  	ii += 2;
	}
}
//输出汉字和字符混合字符串
void OLED_Print(unsigned char x, unsigned char y, unsigned char ch[])
{
	unsigned char ch2[3];
	unsigned int ii=0;        
	while(ch[ii] != '\0')
	{
		if(ch[ii] > 127)
		{
			ch2[0] = ch[ii];
	 		ch2[1] = ch[ii + 1];
			ch2[2] = '\0';			//汉字为两个字节
			OLED_P14x16Str(x , y, ch2);	//显示汉字
			x += 14;
			ii += 2;
		}
		else
		{
			ch2[0] = ch[ii];	
			ch2[1] = '\0';			//字母占一个字节
			OLED_P8x16Str(x , y , ch2);	//显示字母
			x += 8;
			ii+= 1;
		}
	}
} 

//==============================================================
//函数名： void Draw_BMP(unsigned char x,unsigned char y)
//功能描述：显示BMP图片128×64
//参数：起始点坐标(x,y),x的范围0～127，y为页的范围0～7
//返回：无
//==============================================================
void Draw_BMP(unsigned char * bmp)
{ 	
  unsigned int ii=0;
  unsigned char x,y;
  
	for(y=0;y<8;y++)
	{
		OLED_Set_Pos(0,y);				
    for(x=0;x<128;x++)
	    {      
	    	OLED_WrDat(bmp[ii++]);	    	
	    }
	}
}


//void OLED_PrintU16(unsigned char x,unsigned char y,unsigned int num)
//{
//	unsigned char tmp[6],i;
//	tmp[5]=0;
//	tmp[4]=(unsigned char)(num%10+0x30);
//	tmp[3]=(unsigned char)(num/10%10+0x30);
//	tmp[2]=(unsigned char)(num/100%10+0x30);
//	tmp[1]=(unsigned char)(num/1000%10+0x30);
//	tmp[0]=(unsigned char)(num/10000%10+0x30);
//	
//	for(i=0;i<4;i++)
//	{
//		if(tmp[i]=='0')
//			tmp[i]=' ';
//		else
//			break;
//	}
//	
//	OLED_P6x8Str(x,y,tmp);
//	
//}
//void OLED_PrintFloat(unsigned char x,unsigned char y,float num) //不常用，最好别用
//{
//	unsigned char tmp[6],i;
//	tmp[5]=0;
//	num *= 10;
//	if(num>0)
//	{
//		tmp[0]='+';
//		tmp[4]=(unsigned char)((int)num%10+0x30);
//		tmp[3]=(unsigned char)((int)num/10%10+0x30);
//		tmp[2]=(unsigned char)((int)num/100%10+0x30);
//		tmp[1]=(unsigned char)((int)num/1000%10+0x30);
//	}
//	else
//	{
//		tmp[0]='-';
//		num=-num;
//		tmp[4]=(unsigned char)((int)num%10+0x30);
//		tmp[3]=(unsigned char)((int)num/10%10+0x30);
//		tmp[2]=(unsigned char)((int)num/100%10+0x30);
//		tmp[1]=(unsigned char)((int)num/1000%10+0x30);
//	}
//	for(i=0;i<4;i++)
//	{
//		if(tmp[i]=='0')
//			tmp[i]=' ';
//		else
//			break;
//	}
//	OLED_P6x8Str(x,y,tmp);
//}

